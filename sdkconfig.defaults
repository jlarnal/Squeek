## sdkconfig.defaults
```kconfig
CONFIG_AUTOSTART_ARDUINO=y
CONFIG_ESPTOOLPY_FLASHSIZE_4MB=y
CONFIG_ESPTOOLPY_FLASHSIZE="4MB"
CONFIG_FREERTOS_HZ=1000

# WiFi Mesh
CONFIG_ESP_WIFI_MESH_ENABLE=y

# WiFi FTM (Fine Timing Measurement)
CONFIG_ESP_WIFI_FTM_ENABLE=y
CONFIG_ESP_WIFI_FTM_INITIATOR_SUPPORT=y
CONFIG_ESP_WIFI_FTM_RESPONDER_SUPPORT=y

# Power Management
CONFIG_PM_ENABLE=y
CONFIG_FREERTOS_USE_TICKLESS_IDLE=y
CONFIG_ESP_SLEEP_GPIO_RESET_WORKAROUND=y

# WiFi power save (needed for light sleep with WiFi)
CONFIG_ESP_WIFI_SLP_IRAM_OPT=y
CONFIG_ESP_WIFI_SLP_DEFAULT_MIN_ACTIVE_TIME=50
CONFIG_ESP_WIFI_SLP_DEFAULT_MAX_ACTIVE_TIME=300

# ── Disable unused components (pulled by pioarduino framework) ──

# Bluetooth — not used, saves ~200KB flash
CONFIG_BT_ENABLED=n

# Zigbee — not used
CONFIG_ZB_ENABLED=n

# OpenThread (802.15.4 mesh) — not used
CONFIG_OPENTHREAD_ENABLED=n

# ESP Insights — cloud telemetry, not used
CONFIG_ESP_INSIGHTS_ENABLED=n

# ESP Rainmaker — cloud platform, not used
CONFIG_ESP_RMAKER_NETWORK_OVER_WIFI=n

# LittleFS SDMMC — no SD card
CONFIG_LITTLEFS_SDMMC_SUPPORT=n
```
