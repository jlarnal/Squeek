// Tone data — edit this file to add/change tones.
// Shared by C++ firmware (#include) and tools/tone_sim.py (parsed).
//
// Segment fields: { freq_start_hz, freq_end_hz, duty_start, duty_end, duration_ms }
//   freq 0 + duty 0 = silence.  duty 0-255 maps to envelope amplitude.
//
// Structure: segments → variation arrays (ToneSequence[]) → group table (ToneGroup[])
// Playing a group picks a random variation.

// ============================================================
// Segment arrays
// ============================================================

// --- chirps group ---

static const ToneSegment s_chirp_segs[] = {
    {  1000,  4000, 200, 200,  150 },
};

static const ToneSegment s_chirp_down_segs[] = {
    {  4000,  1000, 200, 200,  150 },
};

static const ToneSegment s_squeak_segs[] = {
    {  2000,  4000, 220, 220,   80 },
    {  4000,  2000, 220, 220,   80 },
};

static const ToneSegment s_fade_chirp_segs[] = {
    {  2000,  4000, 200, 200,  120 },
    {     0,     0,   0,   0,   40 },
    {  1500,  3000, 200, 200,   80 },
    {     0,     0,   0,   0,   40 },
    {  1000,  2000, 200, 200,   50 },
    {     0,     0,   0,   0,   40 },
    {   800,  1200, 200, 200,   30 },
};

// --- ringtone group ---

static const ToneSegment s_warble_segs[] = {
    {  3000,  3000, 200, 200,   60 },
    {  1500,  1500, 200, 200,   60 },
    {  3000,  3000, 200, 200,   60 },
    {  1500,  1500, 200, 200,   60 },
};

static const ToneSegment s_alert_segs[] = {
    {  2500,  2500, 200, 200,  250 },
    {     0,     0,   0,   0,  150 },
    {  2500,  2500, 200, 200,  250 },
};

// --- scratch group: mouse-on-wood variations (burst+pause+burst) ---

// scratch — classic 2+pause+3
static const ToneSegment s_scratch_segs[] = {
    {   450,   250, 200, 180,   25 },
    {     0,     0,   0,   0,   15 },
    {   400,   220, 190, 170,   20 },
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    {   380,   180, 170, 140,   20 },
};

// scratch2 — mirrored 3+pause+2
static const ToneSegment s_scratch2_segs[] = {
    {   480,   260, 200, 180,   20 },
    {     0,     0,   0,   0,   10 },
    {   420,   240, 190, 170,   25 },
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    {   450,   200, 190, 150,   25 },
};

// scratch3 — tentative: 1, pause, 2, pause, 1
static const ToneSegment s_scratch3_segs[] = {
    {   350,   200, 180, 150,   30 },
    {     0,     0,   0,   0,   60 },
    {   400,   250, 200, 170,   20 },
    {     0,     0,   0,   0,   15 },
    {   450,   220, 190, 160,   25 },
    {     0,     0,   0,   0,   55 },
    {   320,   180, 170, 130,   25 },
};

// scratch_fast — frantic flurry, 7 rapid strokes, minimal gaps
static const ToneSegment s_scratch_fast_segs[] = {
    {   500,   300, 210, 190,   15 },
    {     0,     0,   0,   0,   10 },
    {   480,   280, 200, 180,   15 },
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    {   480,   220, 180, 140,   10 },
};

// scratch_slow — deliberate, longer strokes, bigger gaps
static const ToneSegment s_scratch_slow_segs[] = {
    {   350,   200, 200, 170,   45 },
    {     0,     0,   0,   0,   35 },
    {   380,   220, 190, 160,   40 },
    {     0,     0,   0,   0,   80 },
    {   320,   180, 200, 170,   50 },
    {     0,     0,   0,   0,   30 },
    {   300,   160, 170, 140,   45 },
};

// scratch_soft — gentle, low duty
static const ToneSegment s_scratch_soft_segs[] = {
    {   500,   350, 140, 120,   20 },
    {     0,     0,   0,   0,   15 },
    {   480,   320, 130, 110,   25 },
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    {   460,   300, 130, 100,   15 },
};

// scratch_deep — heavy paw, lower freq range
static const ToneSegment s_scratch_deep_segs[] = {
    {   280,   140, 220, 200,   30 },
    {     0,     0,   0,   0,   15 },
    {   250,   120, 210, 190,   35 },
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    {   220,   110, 200, 160,   30 },
};

// scratch_flurry — sustained bout: 3+pause+3+pause+2
static const ToneSegment s_scratch_flurry_segs[] = {
    {   480,   280, 200, 180,   20 },
    {     0,     0,   0,   0,   10 },
    {   450,   250, 190, 170,   20 },
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    {   400,   180, 170, 130,   20 },
};

// scratch_tap — mix of flat-freq taps + sweep scratches
static const ToneSegment s_scratch_tap_segs[] = {
    {   350,   350, 200, 200,   10 },
    {     0,     0,   0,   0,   20 },
    {   450,   250, 190, 170,   25 },
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    {   380,   380, 180, 180,   10 },
};

// scratch_seek — exploratory, accelerating (slow strokes -> rapid)
static const ToneSegment s_scratch_seek_segs[] = {
    {   350,   220, 180, 150,   40 },
    {     0,     0,   0,   0,   50 },
    {   380,   240, 190, 160,   30 },
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    {   500,   280, 200, 160,   15 },
};

// --- scritches group: scratch x20 freq (2-10 kHz, piezo sweet spot) ---

static const ToneSegment s_scritch_segs[] = {
    {  9000,  5000, 200, 180,   25 },
    {     0,     0,   0,   0,   15 },
    {  8000,  4400, 190, 170,   20 },
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    {  7600,  3600, 170, 140,   20 },
};

static const ToneSegment s_scritch2_segs[] = {
    {  9600,  5200, 200, 180,   20 },
    {     0,     0,   0,   0,   10 },
    {  8400,  4800, 190, 170,   25 },
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    {  9000,  4000, 190, 150,   25 },
};

static const ToneSegment s_scritch3_segs[] = {
    {  7000,  4000, 180, 150,   30 },
    {     0,     0,   0,   0,   60 },
    {  8000,  5000, 200, 170,   20 },
    {     0,     0,   0,   0,   15 },
    {  9000,  4400, 190, 160,   25 },
    {     0,     0,   0,   0,   55 },
    {  6400,  3600, 170, 130,   25 },
};

static const ToneSegment s_scritch_fast_segs[] = {
    { 10000,  6000, 210, 190,   15 },
    {     0,     0,   0,   0,   10 },
    {  9600,  5600, 200, 180,   15 },
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    {  9600,  4400, 180, 140,   10 },
};

static const ToneSegment s_scritch_slow_segs[] = {
    {  7000,  4000, 200, 170,   45 },
    {     0,     0,   0,   0,   35 },
    {  7600,  4400, 190, 160,   40 },
    {     0,     0,   0,   0,   80 },
    {  6400,  3600, 200, 170,   50 },
    {     0,     0,   0,   0,   30 },
    {  6000,  3200, 170, 140,   45 },
};

static const ToneSegment s_scritch_soft_segs[] = {
    { 10000,  7000, 140, 120,   20 },
    {     0,     0,   0,   0,   15 },
    {  9600,  6400, 130, 110,   25 },
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    {  9200,  6000, 130, 100,   15 },
};

static const ToneSegment s_scritch_deep_segs[] = {
    {  5600,  2800, 220, 200,   30 },
    {     0,     0,   0,   0,   15 },
    {  5000,  2400, 210, 190,   35 },
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    {  4400,  2200, 200, 160,   30 },
};

static const ToneSegment s_scritch_flurry_segs[] = {
    {  9600,  5600, 200, 180,   20 },
    {     0,     0,   0,   0,   10 },
    {  9000,  5000, 190, 170,   20 },
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    {  8000,  3600, 170, 130,   20 },
};

static const ToneSegment s_scritch_tap_segs[] = {
    {  7000,  7000, 200, 200,   10 },
    {     0,     0,   0,   0,   20 },
    {  9000,  5000, 190, 170,   25 },
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    {  7600,  7600, 180, 180,   10 },
};

static const ToneSegment s_scritch_seek_segs[] = {
    {  7000,  4400, 180, 150,   40 },
    {     0,     0,   0,   0,   50 },
    {  7600,  4800, 190, 160,   30 },
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    { 10000,  5600, 200, 160,   15 },
};

// --- crickets group: tonal pulses >5300 Hz, flat freq per pulse ---

// cricket1 — classic double 5500 Hz
static const ToneSegment s_cricket1_segs[] = {
    {  5500,  5500, 200, 200,   40 },
    {     0,     0,   0,   0,   30 },
    {  5500,  5500, 200, 200,   40 },
};

// cricket2 — classic double 6000 Hz
static const ToneSegment s_cricket2_segs[] = {
    {  6000,  6000, 200, 200,   35 },
    {     0,     0,   0,   0,   25 },
    {  6000,  6000, 200, 200,   35 },
};

// cricket3 — triple 5800 Hz
static const ToneSegment s_cricket3_segs[] = {
    {  5800,  5800, 200, 200,   30 },
    {     0,     0,   0,   0,   20 },
    {  5800,  5800, 200, 200,   30 },
    {     0,     0,   0,   0,   20 },
    {  5800,  5800, 200, 200,   30 },
};

// cricket4 — single long 5500 Hz
static const ToneSegment s_cricket4_segs[] = {
    {  5500,  5500, 180, 200,   80 },
};

// cricket5 — rapid double 6500 Hz
static const ToneSegment s_cricket5_segs[] = {
    {  6500,  6500, 210, 210,   25 },
    {     0,     0,   0,   0,   15 },
    {  6500,  6500, 210, 210,   25 },
};

// cricket6 — 6-pulse trill 6000 Hz
static const ToneSegment s_cricket6_segs[] = {
    {  6000,  6000, 200, 200,   20 },
    {     0,     0,   0,   0,   10 },
    {  6000,  6000, 200, 200,   20 },
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    {  6000,  6000, 200, 200,   20 },
};

// cricket7 — 5-pulse slower trill 5500 Hz
static const ToneSegment s_cricket7_segs[] = {
    {  5500,  5500, 190, 190,   30 },
    {     0,     0,   0,   0,   20 },
    {  5500,  5500, 190, 190,   30 },
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    {  5500,  5500, 190, 190,   30 },
};

// cricket8 — slow double 5500 Hz
static const ToneSegment s_cricket8_segs[] = {
    {  5500,  5500, 200, 200,   50 },
    {     0,     0,   0,   0,   60 },
    {  5500,  5500, 200, 200,   50 },
};

// cricket9 — high double 7500 Hz
static const ToneSegment s_cricket9_segs[] = {
    {  7500,  7500, 200, 200,   30 },
    {     0,     0,   0,   0,   20 },
    {  7500,  7500, 200, 200,   30 },
};

// cricket10 — mellow double 5500 Hz
static const ToneSegment s_cricket10_segs[] = {
    {  5500,  5500, 180, 180,   45 },
    {     0,     0,   0,   0,   35 },
    {  5500,  5500, 180, 180,   45 },
};

// cricket11 — katydid "ka-ty-did" 6500 Hz
static const ToneSegment s_cricket11_segs[] = {
    {  6500,  6500, 180, 180,   20 },
    {     0,     0,   0,   0,   15 },
    {  6500,  6500, 200, 200,   30 },
    {     0,     0,   0,   0,   15 },
    {  6500,  6500, 200, 200,   40 },
};

// cricket12 — 4-pulse burst 6000 Hz
static const ToneSegment s_cricket12_segs[] = {
    {  6000,  6000, 210, 210,   15 },
    {     0,     0,   0,   0,   10 },
    {  6000,  6000, 210, 210,   15 },
    {     0,     0,   0,   0,   10 },
    {  6000,  6000, 210, 210,   15 },
    {     0,     0,   0,   0,   10 },
    {  6000,  6000, 210, 210,   15 },
};

// cricket13 — 8-pulse extended trill 5800 Hz
static const ToneSegment s_cricket13_segs[] = {
    {  5800,  5800, 200, 200,   15 },
    {     0,     0,   0,   0,   10 },
    {  5800,  5800, 200, 200,   15 },
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    {  5800,  5800, 200, 200,   15 },
};

// cricket14 — stutter: 1 + pause + 2 at 5800 Hz
static const ToneSegment s_cricket14_segs[] = {
    {  5800,  5800, 200, 200,   35 },
    {     0,     0,   0,   0,   80 },
    {  5800,  5800, 200, 200,   30 },
    {     0,     0,   0,   0,   20 },
    {  5800,  5800, 200, 200,   30 },
};

// cricket15 — chirp with quieter echo 6000 Hz
static const ToneSegment s_cricket15_segs[] = {
    {  6000,  6000, 220, 220,   35 },
    {     0,     0,   0,   0,   50 },
    {  6000,  6000, 120, 120,   35 },
};

// cricket16 — warm double 5500 Hz
static const ToneSegment s_cricket16_segs[] = {
    {  5500,  5500, 200, 200,   50 },
    {     0,     0,   0,   0,   40 },
    {  5500,  5500, 200, 200,   50 },
};

// cricket17 — bright double 7500 Hz
static const ToneSegment s_cricket17_segs[] = {
    {  7500,  7500, 190, 190,   25 },
    {     0,     0,   0,   0,   20 },
    {  7500,  7500, 190, 190,   25 },
};

// cricket18 — quick triple 6500 Hz
static const ToneSegment s_cricket18_segs[] = {
    {  6500,  6500, 200, 200,   20 },
    {     0,     0,   0,   0,   10 },
    {  6500,  6500, 200, 200,   20 },
    {     0,     0,   0,   0,   10 },
    {  6500,  6500, 200, 200,   20 },
};

// cricket19 — long pause double 5800 Hz
static const ToneSegment s_cricket19_segs[] = {
    {  5800,  5800, 200, 200,   40 },
    {     0,     0,   0,   0,  150 },
    {  5800,  5800, 200, 200,   40 },
};

// cricket20 — flutter: 4 pulses ascending 5500-7000 Hz
static const ToneSegment s_cricket20_segs[] = {
    {  5500,  5500, 190, 190,   20 },
    {     0,     0,   0,   0,   10 },
    {  6000,  6000, 200, 200,   20 },
    {     0,     0,   0,   0,   10 },
    {  6500,  6500, 210, 210,   20 },
    {     0,     0,   0,   0,   10 },
    {  7000,  7000, 200, 200,   20 },
};

// --- dripdrop group: descending "plop" tones x1.6 freq, duty fades ---

// drip1 — single drop
static const ToneSegment s_drip1_segs[] = {
    {  2400,   480, 220, 100,   50 },
};

// drip2 — single drop, different pitch
static const ToneSegment s_drip2_segs[] = {
    {  1920,   400, 200,  80,   60 },
};

// drip3 — double drip
static const ToneSegment s_drip3_segs[] = {
    {  2400,   560, 220, 100,   45 },
    {     0,     0,   0,   0,  120 },
    {  2240,   480, 200,  90,   45 },
};

// drip4 — triple, getting quieter
static const ToneSegment s_drip4_segs[] = {
    {  2400,   480, 220, 110,   45 },
    {     0,     0,   0,   0,  100 },
    {  2240,   450, 180,  80,   40 },
    {     0,     0,   0,   0,   90 },
    {  2080,   400, 140,  60,   35 },
};

// drip5 — big drop, low and slow
static const ToneSegment s_drip5_segs[] = {
    {  1280,   240, 220, 120,   80 },
};

// drip6 — tiny high drop
static const ToneSegment s_drip6_segs[] = {
    {  3200,   800, 180,  80,   30 },
};

// drip7 — drop + quieter echo
static const ToneSegment s_drip7_segs[] = {
    {  2400,   480, 220, 100,   50 },
    {     0,     0,   0,   0,   80 },
    {  1920,   560, 120,  50,   40 },
};

// drip8 — rapid double
static const ToneSegment s_drip8_segs[] = {
    {  2240,   480, 220, 100,   40 },
    {     0,     0,   0,   0,   50 },
    {  2400,   560, 210,  90,   40 },
};

// drip9 — slow double, long pause
static const ToneSegment s_drip9_segs[] = {
    {  2080,   450, 200, 100,   55 },
    {     0,     0,   0,   0,  200 },
    {  2240,   480, 210, 100,   50 },
};

// drip10 — cascade: 4 drops accelerating
static const ToneSegment s_drip10_segs[] = {
    {  2400,   480, 220, 100,   50 },
    {     0,     0,   0,   0,  120 },
    {  2240,   450, 210,  90,   45 },
    {     0,     0,   0,   0,   80 },
    {  2080,   420, 200,  80,   40 },
    {     0,     0,   0,   0,   50 },
    {  1920,   380, 190,  70,   35 },
};

// drip11 — splash: drop + short burst
static const ToneSegment s_drip11_segs[] = {
    {  2400,   400, 220, 100,   50 },
    {     0,     0,   0,   0,   10 },
    {   960,   640, 160, 100,   15 },
    {   800,   480, 120,  60,   15 },
};

// drip12 — deep drop
static const ToneSegment s_drip12_segs[] = {
    {   960,   160, 220, 120,   70 },
};

// drip13 — high drop
static const ToneSegment s_drip13_segs[] = {
    {  4000,  1280, 200,  80,   35 },
};

// drip14 — 3 drops fading
static const ToneSegment s_drip14_segs[] = {
    {  2400,   480, 220, 110,   45 },
    {     0,     0,   0,   0,   80 },
    {  2240,   480, 160,  80,   45 },
    {     0,     0,   0,   0,   80 },
    {  2080,   480, 100,  40,   45 },
};

// drip15 — bouncing ball: drops getting shorter and faster
static const ToneSegment s_drip15_segs[] = {
    {  2240,   480, 220, 100,   50 },
    {     0,     0,   0,   0,  100 },
    {  2400,   560, 200,  90,   40 },
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    {  2880,   800, 140,  60,   15 },
};

// drip16 — heavy thick drop
static const ToneSegment s_drip16_segs[] = {
    {  1120,   190, 220, 140,   90 },
};

// drip17 — delicate light drop
static const ToneSegment s_drip17_segs[] = {
    {  2880,   960, 150,  60,   25 },
};

// drip18 — pair of identical drops
static const ToneSegment s_drip18_segs[] = {
    {  2080,   480, 210, 100,   45 },
    {     0,     0,   0,   0,  100 },
    {  2080,   480, 210, 100,   45 },
};

// drip19 — stutter: drop, tiny gap, drop, pause, drop
static const ToneSegment s_drip19_segs[] = {
    {  2400,   560, 220, 100,   40 },
    {     0,     0,   0,   0,   25 },
    {  2240,   480, 200,  90,   35 },
    {     0,     0,   0,   0,  120 },
    {  2080,   450, 190,  80,   45 },
};

// drip20 — trickle: 5 tiny rapid drops
static const ToneSegment s_drip20_segs[] = {
    {  2880,   800, 180,  80,   20 },
    {     0,     0,   0,   0,   30 },
    {  2720,   770, 170,  70,   20 },
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    {  2800,   800, 170,  60,   20 },
};

// --- buzzes group: ultra-low elytra buzz 15-90 Hz, gaps ≤35ms ---

// buzz1 — classic 8-pulse even 50 Hz
static const ToneSegment s_buzz1_segs[] = {
    {    50,    50, 220, 220,   75 },
    {     0,     0,   0,   0,   35 },
    {    50,    50, 220, 220,   75 },
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    {    50,    50, 220, 220,   75 },
};

// buzz2 — 8-pulse jittered 35-65 Hz
static const ToneSegment s_buzz2_segs[] = {
    {    40,    40, 220, 210,   70 },
    {     0,     0,   0,   0,   30 },
    {    55,    55, 220, 220,   80 },
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    {    55,    55, 220, 200,   75 },
};

// buzz3 — 6-pulse 70 Hz
static const ToneSegment s_buzz3_segs[] = {
    {    70,    70, 220, 220,   60 },
    {     0,     0,   0,   0,   30 },
    {    70,    70, 220, 220,   60 },
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    {    70,    70, 220, 220,   60 },
};

// buzz4 — 10-pulse rapid-fire 45 Hz
static const ToneSegment s_buzz4_segs[] = {
    {    45,    45, 220, 220,   50 },
    {     0,     0,   0,   0,   20 },
    {    45,    45, 220, 220,   50 },
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    {    45,    45, 220, 220,   50 },
};

// buzz5 — 5-pulse slow 25 Hz
static const ToneSegment s_buzz5_segs[] = {
    {    25,    25, 220, 220,   90 },
    {     0,     0,   0,   0,   35 },
    {    25,    25, 220, 220,   90 },
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    {    25,    25, 220, 220,   90 },
};

// buzz6 — 8-pulse ascending 15→90 Hz
static const ToneSegment s_buzz6_segs[] = {
    {    15,    15, 220, 220,   75 },
    {     0,     0,   0,   0,   30 },
    {    25,    25, 220, 220,   75 },
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    {    90,    90, 220, 220,   75 },
};

// buzz7 — 8-pulse descending 90→15 Hz
static const ToneSegment s_buzz7_segs[] = {
    {    90,    90, 220, 220,   75 },
    {     0,     0,   0,   0,   30 },
    {    80,    80, 220, 220,   75 },
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    {    15,    15, 220, 220,   75 },
};

// buzz8 — 4-pulse heavy 20 Hz
static const ToneSegment s_buzz8_segs[] = {
    {    20,    20, 220, 220,  100 },
    {     0,     0,   0,   0,   35 },
    {    20,    20, 220, 220,  100 },
    {     0,     0,   0,   0,   35 },
    {    20,    20, 220, 220,  100 },
    {     0,     0,   0,   0,   35 },
    {    20,    20, 220, 220,  100 },
};

// buzz9 — 8-pulse fading duty 50 Hz
static const ToneSegment s_buzz9_segs[] = {
    {    50,    50, 220, 220,   75 },
    {     0,     0,   0,   0,   35 },
    {    50,    50, 210, 210,   75 },
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    {    50,    50, 100, 100,   75 },
};

// buzz10 — 3+pause+5 stutter 60 Hz
static const ToneSegment s_buzz10_segs[] = {
    {    60,    60, 220, 220,   70 },
    {     0,     0,   0,   0,   25 },
    {    60,    60, 220, 220,   70 },
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    {    60,    60, 220, 220,   60 },
};

// buzz11 — 8-pulse 85 Hz
static const ToneSegment s_buzz11_segs[] = {
    {    85,    85, 220, 220,   70 },
    {     0,     0,   0,   0,   30 },
    {    85,    85, 220, 220,   70 },
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    {    85,    85, 220, 220,   70 },
};

// buzz12 — 6-pulse sweep per burst 30→70 Hz
static const ToneSegment s_buzz12_segs[] = {
    {    30,    70, 220, 220,   80 },
    {     0,     0,   0,   0,   30 },
    {    30,    70, 220, 220,   80 },
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    {    30,    70, 220, 220,   80 },
};

// buzz13 — 8-pulse accelerating gaps 50 Hz
static const ToneSegment s_buzz13_segs[] = {
    {    50,    50, 220, 220,   75 },
    {     0,     0,   0,   0,   35 },
    {    50,    50, 220, 220,   75 },
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    {    50,    50, 220, 220,   75 },
};

// buzz14 — 8-pulse decelerating gaps 50 Hz
static const ToneSegment s_buzz14_segs[] = {
    {    50,    50, 220, 220,   75 },
    {     0,     0,   0,   0,    5 },
    {    50,    50, 220, 220,   75 },
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    {    50,    50, 220, 220,   75 },
};

// buzz15 — 8-pulse soft 40 Hz lower duty
static const ToneSegment s_buzz15_segs[] = {
    {    40,    40, 150, 150,   75 },
    {     0,     0,   0,   0,   35 },
    {    40,    40, 150, 150,   75 },
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    {    40,    40, 150, 150,   75 },
};

// buzz16 — 12-pulse rapid 75 Hz
static const ToneSegment s_buzz16_segs[] = {
    {    75,    75, 220, 220,   40 },
    {     0,     0,   0,   0,   15 },
    {    75,    75, 220, 220,   40 },
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    {    75,    75, 220, 220,   40 },
};

// buzz17 — 3-pulse short burst 55 Hz
static const ToneSegment s_buzz17_segs[] = {
    {    55,    55, 220, 220,   80 },
    {     0,     0,   0,   0,   35 },
    {    55,    55, 220, 220,   80 },
    {     0,     0,   0,   0,   35 },
    {    55,    55, 220, 220,   80 },
};

// buzz18 — 8-pulse alternating 30/80 Hz
static const ToneSegment s_buzz18_segs[] = {
    {    30,    30, 220, 220,   70 },
    {     0,     0,   0,   0,   30 },
    {    80,    80, 220, 220,   70 },
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    {    80,    80, 220, 220,   70 },
};

// buzz19 — 8-pulse growing intensity 50 Hz
static const ToneSegment s_buzz19_segs[] = {
    {    50,    50, 100, 100,   75 },
    {     0,     0,   0,   0,   35 },
    {    50,    50, 120, 120,   75 },
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    {    50,    50, 220, 220,   75 },
};

// buzz20 — 2+pause+3+pause+3 grouped 60 Hz
static const ToneSegment s_buzz20_segs[] = {
    {    60,    60, 220, 220,   70 },
    {     0,     0,   0,   0,   25 },
    {    60,    60, 220, 220,   70 },
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    {    60,    60, 220, 220,   60 },
};

// --- cicada group: high-freq rasp 8000-10000 Hz, low duty (20-30%) ---

// cicada1 — 5-cycle click+rasp 8500 Hz
static const ToneSegment s_cicada1_segs[] = {
    {  8500,  8500,  65,  65,   35 },
    {     0,     0,   0,   0,   25 },
    {  8500,  8500,  60,  60,   35 },
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    {  8600,  8600,  50,  50,   35 },
};

// cicada2 — 4-cycle 9500 Hz
static const ToneSegment s_cicada2_segs[] = {
    {  9500,  9500,  70,  70,   30 },
    {     0,     0,   0,   0,   20 },
    {  9500,  9500,  65,  65,   40 },
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    {  9400,  9400,  50,  50,   35 },
};

// cicada3 — 6-cycle fast 8000 Hz
static const ToneSegment s_cicada3_segs[] = {
    {  8000,  8000,  70,  70,   25 },
    {     0,     0,   0,   0,   15 },
    {  8200,  8200,  65,  65,   25 },
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    {  8000,  8000,  50,  50,   25 },
};

// cicada4 — 3-cycle slow 9000 Hz
static const ToneSegment s_cicada4_segs[] = {
    {  9000,  9000,  75,  75,   50 },
    {     0,     0,   0,   0,   30 },
    {  9200,  9200,  70,  70,   50 },
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    {  9000,  9000,  55,  55,   50 },
};

// cicada5 — 5-cycle rising 8000→10000 Hz
static const ToneSegment s_cicada5_segs[] = {
    {  8000,  8000,  70,  70,   35 },
    {     0,     0,   0,   0,   50 },
    {  8500,  8500,  70,  70,   35 },
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    { 10000, 10000,  55,  55,   35 },
};

// cicada6 — 4-cycle pure tone 8500 Hz
static const ToneSegment s_cicada6_segs[] = {
    {  8500,  8500,  70,  70,   60 },
    {     0,     0,   0,   0,   40 },
    {  8600,  8600,  65,  65,   55 },
    {     0,     0,   0,   0,   40 },
    {  8500,  8500,  60,  60,   60 },
    {     0,     0,   0,   0,   40 },
    {  8700,  8700,  55,  55,   50 },
};

// cicada7 — 3-cycle sweep 8000→9500 Hz
static const ToneSegment s_cicada7_segs[] = {
    {  8000,  9500,  75,  50,   50 },
    {     0,     0,   0,   0,   70 },
    {  8000,  9500,  70,  50,   50 },
    {     0,     0,   0,   0,   70 },
    {  8000,  9500,  65,  50,   50 },
};

// cicada8 — 5-cycle double-pulse + tone
static const ToneSegment s_cicada8_segs[] = {
    {  8500,  8500,  75,  75,   20 },
    {     0,     0,   0,   0,   10 },
    {  8500,  8500,  65,  65,   20 },
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    {  8800,  8800,  50,  50,   35 },
};

// cicada9 — 4-cycle fading duty 9000 Hz
static const ToneSegment s_cicada9_segs[] = {
    {  9000,  9000,  75,  75,   40 },
    {     0,     0,   0,   0,   50 },
    {  9000,  9000,  65,  65,   40 },
    {     0,     0,   0,   0,   50 },
    {  9000,  9000,  55,  55,   40 },
    {     0,     0,   0,   0,   50 },
    {  9000,  9000,  50,  50,   40 },
};

// cicada10 — 5-cycle alternating 8500/9500 Hz
static const ToneSegment s_cicada10_segs[] = {
    {  8500,  8500,  70,  70,   35 },
    {     0,     0,   0,   0,   50 },
    {  9500,  9500,  65,  65,   35 },
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    {  8500,  8500,  55,  55,   35 },
};

// ============================================================
// Variation arrays (ToneSequence[] per group)
// ============================================================

static const ToneSequence s_chirps_vars[] = {
    { s_chirp_segs,       1, 0 },
    { s_chirp_down_segs,  1, 0 },
    { s_squeak_segs,      2, 0 },
    { s_fade_chirp_segs,  7, 0 },
};

static const ToneSequence s_ringtone_vars[] = {
    { s_warble_segs,  4, 0 },
    { s_alert_segs,   3, 0 },
};

static const ToneSequence s_scratch_vars[] = {
    { s_scratch_segs,        9, 0 },
    { s_scratch2_segs,       9, 0 },
    { s_scratch3_segs,       7, 0 },
    { s_scratch_fast_segs,  13, 0 },
    { s_scratch_slow_segs,   7, 0 },
    { s_scratch_soft_segs,   9, 0 },
    { s_scratch_deep_segs,   9, 0 },
    { s_scratch_flurry_segs,15, 0 },
    { s_scratch_tap_segs,    9, 0 },
    { s_scratch_seek_segs,  11, 0 },
};

static const ToneSequence s_scritches_vars[] = {
    { s_scritch_segs,        9, 0 },
    { s_scritch2_segs,       9, 0 },
    { s_scritch3_segs,       7, 0 },
    { s_scritch_fast_segs,  13, 0 },
    { s_scritch_slow_segs,   7, 0 },
    { s_scritch_soft_segs,   9, 0 },
    { s_scritch_deep_segs,   9, 0 },
    { s_scritch_flurry_segs,15, 0 },
    { s_scritch_tap_segs,    9, 0 },
    { s_scritch_seek_segs,  11, 0 },
};

static const ToneSequence s_crickets_vars[] = {
    { s_cricket1_segs,   3, 0 },
    { s_cricket2_segs,   3, 0 },
    { s_cricket3_segs,   5, 0 },
    { s_cricket4_segs,   1, 0 },
    { s_cricket5_segs,   3, 0 },
    { s_cricket6_segs,  11, 0 },
    { s_cricket7_segs,   9, 0 },
    { s_cricket8_segs,   3, 0 },
    { s_cricket9_segs,   3, 0 },
    { s_cricket10_segs,  3, 0 },
    { s_cricket11_segs,  5, 0 },
    { s_cricket12_segs,  7, 0 },
    { s_cricket13_segs, 15, 0 },
    { s_cricket14_segs,  5, 0 },
    { s_cricket15_segs,  3, 0 },
    { s_cricket16_segs,  3, 0 },
    { s_cricket17_segs,  3, 0 },
    { s_cricket18_segs,  5, 0 },
    { s_cricket19_segs,  3, 0 },
    { s_cricket20_segs,  7, 0 },
};

static const ToneSequence s_dripdrop_vars[] = {
    { s_drip1_segs,   1, 0 },
    { s_drip2_segs,   1, 0 },
    { s_drip3_segs,   3, 0 },
    { s_drip4_segs,   5, 0 },
    { s_drip5_segs,   1, 0 },
    { s_drip6_segs,   1, 0 },
    { s_drip7_segs,   3, 0 },
    { s_drip8_segs,   3, 0 },
    { s_drip9_segs,   3, 0 },
    { s_drip10_segs,  7, 0 },
    { s_drip11_segs,  4, 0 },
    { s_drip12_segs,  1, 0 },
    { s_drip13_segs,  1, 0 },
    { s_drip14_segs,  5, 0 },
    { s_drip15_segs,  9, 0 },
    { s_drip16_segs,  1, 0 },
    { s_drip17_segs,  1, 0 },
    { s_drip18_segs,  3, 0 },
    { s_drip19_segs,  5, 0 },
    { s_drip20_segs,  9, 0 },
};

static const ToneSequence s_buzzes_vars[] = {
    { s_buzz1_segs,  15, 0 },
    { s_buzz2_segs,  15, 0 },
    { s_buzz3_segs,  11, 0 },
    { s_buzz4_segs,  19, 0 },
    { s_buzz5_segs,   9, 0 },
    { s_buzz6_segs,  15, 0 },
    { s_buzz7_segs,  15, 0 },
    { s_buzz8_segs,   7, 0 },
    { s_buzz9_segs,  15, 0 },
    { s_buzz10_segs, 15, 0 },
    { s_buzz11_segs, 15, 0 },
    { s_buzz12_segs, 11, 0 },
    { s_buzz13_segs, 15, 0 },
    { s_buzz14_segs, 15, 0 },
    { s_buzz15_segs, 15, 0 },
    { s_buzz16_segs, 23, 0 },
    { s_buzz17_segs,  5, 0 },
    { s_buzz18_segs, 15, 0 },
    { s_buzz19_segs, 15, 0 },
    { s_buzz20_segs, 15, 0 },
};

static const ToneSequence s_cicada_vars[] = {
    { s_cicada1_segs,  19, 0 },
    { s_cicada2_segs,  15, 0 },
    { s_cicada3_segs,  23, 0 },
    { s_cicada4_segs,  11, 0 },
    { s_cicada5_segs,  19, 0 },
    { s_cicada6_segs,   7, 0 },
    { s_cicada7_segs,  11, 0 },
    { s_cicada8_segs,  29, 0 },
    { s_cicada9_segs,  15, 0 },
    { s_cicada10_segs, 19, 0 },
};

// ============================================================
// Group table — public-facing tone names
// ============================================================

static const ToneGroup s_groups[] = {
    { "chirps",    s_chirps_vars,     4 },
    { "ringtone",  s_ringtone_vars,   2 },
    { "scratch",   s_scratch_vars,   10 },
    { "scritches", s_scritches_vars, 10 },
    { "crickets",  s_crickets_vars,  20 },
    { "dripdrop",  s_dripdrop_vars,  20 },
    { "buzzes",    s_buzzes_vars,    20 },
    { "cicada",    s_cicada_vars,    10 },
};
static constexpr int GROUP_COUNT = sizeof(s_groups) / sizeof(s_groups[0]);
